CM_ "Renault 5 E-Tech (CMF-BEV). CHECKSUM uses CRC-8 poly 0x1D init 0 with
per-message XOR. Most messages use a 7-byte protected body before the checksum
byte; 0x134 LKA_CMD is the exception with a tail-positioned CHECKSUM (byte 16,
XOR 0xEB) protecting bytes[17:24].";

BO_ 140 ACC_PEDAL_8C: 12 XXX
 SG_ CHECKSUM : 39|8@0+ (1,0) [0|255] "" XXX
 SG_ COUNTER : 47|4@0+ (1,0) [0|15] "" XXX
 SG_ ACCEL_PEDAL : 55|16@0+ (0.001525902,0) [0|100] "%" XXX

BO_ 274 STEERING_SENSOR_112: 64 XXX
 SG_ CHECKSUM_1 : 39|8@0+ (1,0) [0|255] "" XXX
 SG_ COUNTER_1 : 47|4@0+ (1,0) [0|15] "" XXX
 SG_ BRAKE_LIGHT : 56|1@0+ (1,0) [0|1] "" XXX
 SG_ BRAKE_PRESSED : 57|1@0+ (1,0) [0|1] "" XXX
 SG_ STEER_RATE : 71|8@0+ (1,0) [0|255] "deg/s" XXX
 SG_ CHECKSUM_2 : 111|8@0+ (1,0) [0|255] "" XXX
 SG_ TURN_SIGNAL_LEFT : 112|1@0+ (1,0) [0|1] "" XXX
 SG_ COUNTER_2 : 119|4@0+ (1,0) [0|15] "" XXX
 SG_ STEER_ANGLE_1 : 127|11@0+ (0.2,-204.8) [-204.8|204.6] "deg" XXX
 SG_ FORWARD_GEAR_ACTIVE : 147|1@0+ (1,0) [0|1] "" XXX
 SG_ CHECKSUM_3 : 191|8@0+ (1,0) [0|255] "" XXX
 SG_ COUNTER_3 : 199|4@0+ (1,0) [0|15] "" XXX
 SG_ STEER_ANGLE_2 : 207|11@0+ (0.2,-204.8) [-204.8|204.6] "deg" XXX
 SG_ CHECKSUM_4 : 271|8@0+ (1,0) [0|255] "" XXX
 SG_ COUNTER_4 : 279|4@0+ (1,0) [0|15] "" XXX
 SG_ LONG_ACCEL : 291|10@0+ (0.02,-12.32) [-12.32|8.14] "m/s^2" XXX

BO_ 303 GEAR_12F: 12 XXX
 SG_ CHECKSUM : 39|8@0+ (1,0) [0|255] "" XXX
 SG_ COUNTER : 47|4@0+ (1,0) [0|15] "" XXX
 SG_ GEAR_STATE : 52|4@0+ (1,0) [0|15] "" XXX
 SG_ GEAR_ENGAGED : 53|1@0+ (1,0) [0|1] "" XXX
 SG_ PARK_ACTIVE : 55|1@0+ (1,0) [0|1] "" XXX

BO_ 308 LKA_CMD_134: 24 XXX
 SG_ TORQUE_CMD : 87|8@0+ (1,0) [0|255] "" XXX
 SG_ CHECKSUM : 135|8@0+ (1,0) [0|255] "" XXX
 SG_ LKA_ACTIVE : 139|4@0+ (1,0) [0|15] "" XXX
 SG_ COUNTER : 143|4@0+ (1,0) [0|15] "" XXX

BO_ 380 EPS_17C: 12 XXX
 SG_ CHECKSUM : 39|8@0+ (1,0) [0|255] "" XXX
 SG_ COUNTER : 47|4@0+ (1,0) [0|15] "" XXX
 SG_ EPS_MOTOR_POS : 53|14@0+ (1,0) [0|16383] "" XXX
 SG_ DRIVER_TORQUE : 79|16@0+ (1,-32768) [-32768|32767] "" XXX

BO_ 427 STEERING_CTRL_1AB: 48 XXX
 SG_ CHECKSUM_A : 39|8@0+ (1,0) [0|255] "" XXX
 SG_ COUNTER_A : 47|4@0+ (1,0) [0|15] "" XXX
 SG_ LKAS_TORQUE_CMD : 63|8@0+ (1,-150) [-150|105] "" XXX
 SG_ LKAS_STATE : 74|2@0+ (1,0) [0|3] "" XXX
 SG_ CHECKSUM_B : 119|8@0+ (1,0) [0|255] "" XXX
 SG_ COUNTER_B : 127|4@0+ (1,0) [0|15] "" XXX
 SG_ STEER_ANGLE : 135|16@0+ (0.1,-3276.8) [-3276.8|3276.7] "deg" XXX
 SG_ STEER_TURN_CNT : 151|16@0+ (1,0) [0|65535] "" XXX
 SG_ STEER_RATE : 167|16@0+ (0.01,-327.68) [-327.68|327.67] "deg/s" XXX
 SG_ CHECKSUM_C : 215|8@0+ (1,0) [0|255] "" XXX
 SG_ COUNTER_C : 223|4@0+ (1,0) [0|15] "" XXX

BO_ 548 PEDAL_AND_GEAR_224: 7 XXX
 SG_ BRAKE_PRESSURE : 15|8@0+ (1,0) [0|255] "" XXX

BO_ 550 WHEEL_SPEEDS_226: 48 XXX
 SG_ CHECKSUM_A : 39|8@0+ (1,0) [0|255] "" XXX
 SG_ COUNTER_A : 47|4@0+ (1,0) [0|15] "" XXX
 SG_ WHEEL_SPEED_FL : 55|16@0+ (0.005,0) [0|320] "km/h" XXX
 SG_ WHEEL_SPEED_FR : 71|16@0+ (0.005,0) [0|320] "km/h" XXX
 SG_ CHECKSUM_B : 191|8@0+ (1,0) [0|255] "" XXX
 SG_ COUNTER_B_LO : 179|4@0+ (1,0) [0|15] "" XXX
 SG_ CHECKSUM_C : 287|8@0+ (1,0) [0|255] "" XXX
 SG_ COUNTER_C_LO : 275|4@0+ (1,0) [0|15] "" XXX
 SG_ WHEEL_SPEED_RL : 231|16@0+ (0.005,0) [0|320] "km/h" XXX
 SG_ WHEEL_SPEED_RR : 247|16@0+ (0.005,0) [0|320] "km/h" XXX

BO_ 1018 VEHICLE_SPEED_3FA: 48 XXX
 SG_ VEHICLE_SPEED_KPH : 39|8@0+ (1,0) [0|255] "km/h" XXX
 SG_ COUNTER : 47|4@0+ (1,0) [0|15] "" XXX
 SG_ VEHICLE_SPEED_HIGH_RES : 52|13@0+ (0.00616,0) [0|50] "km/h" XXX
 SG_ CRUISE_SET_SPEED : 87|16@0+ (0.125,0) [0|250] "km/h" XXX
 SG_ ACCEL_PEDAL_LOW_RATE : 167|8@0+ (0.5,-18.5) [-18.5|109] "%" XXX

BO_ 1205 EPS_STATE_4B5: 8 XXX
 SG_ ADAS_ENGAGED : 7|8@0+ (1,0) [0|255] "" XXX

BO_ 1416 BELTS_DOORS_588: 24 XXX
 SG_ CHECKSUM_A : 39|8@0+ (1,0) [0|255] "" XXX
 SG_ COUNTER_A : 47|4@0+ (1,0) [0|15] "" XXX
 SG_ DOOR_DRIVER_OPEN_CANDIDATE : 66|1@0+ (1,0) [0|1] "" XXX
 SG_ BELT_UNBUCKLED_CANDIDATE : 87|1@0+ (1,0) [0|1] "" XXX
 SG_ CHECKSUM_B : 135|8@0+ (1,0) [0|255] "" XXX
 SG_ COUNTER_B : 143|4@0+ (1,0) [0|15] "" XXX
 SG_ TURN_SIGNAL_RIGHT_ECHO : 153|1@0+ (1,0) [0|1] "" XXX

BO_ 1419 TURN_SIGNAL_RIGHT_58B: 12 XXX
 SG_ TURN_SIGNAL_RIGHT : 89|1@0+ (1,0) [0|1] "" XXX

CM_ BO_ 274 "Multi-subframe (64B, 4 subframes) steering sensor on body bus. Carries BRAKE_PRESSED (byte 7 bit 1), TURN_SIGNAL_LEFT, longitudinal accel, redundant 12-bit steering angle. Right turn signal is on 0x58B (R5 splits L/R across buses).";
CM_ BO_ 308 "Byte 16 = CRC-8 (poly 0x1D, XOR 0xEB, body = bytes[17:24]); tail-positioned rather than at byte 4 like every other message in this DBC. Byte 17 high nibble is COUNTER; low nibble is LKA_ACTIVE. Observed raw states are 0, 3, 4, 6, and 7; only 0x6 carried non-zero TORQUE_CMD in the 2026-04-26 stock-drive captures.";
CM_ BO_ 1205 "ADAS_ENGAGED is a multi-state enum; 0 is observed off and multiple non-zero states are observed in driving/assist contexts. Exact per-state semantics are not fully decoded yet.";

CM_ SG_ 1018 CRUISE_SET_SPEED "Cluster's cruise setpoint display source. 16-bit BE at bytes 10-11, scale 0.125 km/h. Raw 1600 (=200 km/h) is the UNSET sentinel when cruise has no target.";

VAL_ 303 GEAR_STATE 1 "R" 2 "N" 3 "B" 8 "D" ;
VAL_ 308 LKA_ACTIVE 0 "ARMED" 3 "DRIVER_OVERRIDE" 4 "TRANSITIONING" 6 "ACTIVE" 7 "ARMED_HI_SPEED" ;
VAL_ 427 LKAS_STATE 1 "ACTIVE_OR_READY" 2 "SUPPRESSED_BY_DRIVER" 3 "UNAVAILABLE" ;
